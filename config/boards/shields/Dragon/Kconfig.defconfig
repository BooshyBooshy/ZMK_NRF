## config/boards/shields/Dragon/Kconfig.defconfig
```kconfig
# Copyright (c) 2020 The ZMK Contributors
# SPDX-License-Identifier: MIT

if SHIELD_DRAGON

config ZMK_KEYBOARD_NAME
    default "Dragon"

endif
```
